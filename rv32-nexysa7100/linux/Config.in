## rv32-nexysa7100/linux/Config.in
```kconfig
# SPDX-License-Identifier: GPL-2.0-only
# 20261120 (c) William Fonkou Tambe

source "$BR2_EXTERNAL_NEXYSA7100_PATH/package/linux-smp/Config.in"
```

## rv32-nexysa7100/linux/package/linux-smp/Config.in
```kconfig
config BR2_PACKAGE_LINUX_SMP
	bool "linux-smp"
	depends on BR2_LINUX_KERNEL
	help
	  The multi-hart kernel of rv32-nexysa7100, whose bitstream is built
	  with the define CPU_COUNT from 1 to 4, and ATOMIC_COHERENCE=1 from
	  2 harts: the sources and patches of the package linux, its
	  configuration linux.config merged with linux-smp.config; its Image
	  is installed to images/smp/.

comment "linux-smp needs the Linux kernel"
	depends on !BR2_LINUX_KERNEL
```

## rv32-orangecrab0285/linux/Config.in
```kconfig
# SPDX-License-Identifier: GPL-2.0-only
# 20261122 (c) William Fonkou Tambe

source "$BR2_EXTERNAL_ORANGECRAB0285_PATH/package/linux-smp/Config.in"
```

## rv32-orangecrab0285/linux/configs/orangecrab0285_defconfig
```kconfig
BR2_riscv=y
BR2_riscv_custom=y
BR2_RISCV_ISA_RVM=y
BR2_RISCV_ISA_RVA=y
BR2_RISCV_32=y
# BR2_RISCV_USE_MMU is not set
BR2_PACKAGE_HOST_LINUX_HEADERS_CUSTOM_6_18=y
# BR2_UCLIBC_INSTALL_UTILS is not set
BR2_TARGET_LDFLAGS="-Wl,-elf2flt=-s32768"
BR2_PACKAGE_OVERRIDE_FILE="$(BR2_EXTERNAL_ORANGECRAB0285_PATH)/override.mk"
BR2_GLOBAL_PATCH_DIR="$(BR2_EXTERNAL_ORANGECRAB0285_PATH)/patches"
BR2_TARGET_GENERIC_HOSTNAME="orangecrab0285"
BR2_ROOTFS_POST_IMAGE_SCRIPT="$(BR2_EXTERNAL_ORANGECRAB0285_PATH)/post-image.sh"
BR2_LINUX_KERNEL=y
BR2_LINUX_KERNEL_CUSTOM_VERSION=y
BR2_LINUX_KERNEL_CUSTOM_VERSION_VALUE="6.18.60"
BR2_LINUX_KERNEL_USE_CUSTOM_CONFIG=y
BR2_LINUX_KERNEL_CUSTOM_CONFIG_FILE="$(BR2_EXTERNAL_ORANGECRAB0285_PATH)/linux.config"
BR2_LINUX_KERNEL_DTS_SUPPORT=y
BR2_LINUX_KERNEL_CUSTOM_DTS_DIR="$(BR2_EXTERNAL_ORANGECRAB0285_PATH)/dts"
BR2_PACKAGE_BUSYBOX_CONFIG_FRAGMENT_FILES="$(BR2_EXTERNAL_ORANGECRAB0285_PATH)/busybox.fragment"
BR2_TARGET_ROOTFS_EXT2=y
BR2_TARGET_ROOTFS_EXT2_SIZE="64M"
BR2_PACKAGE_LINUX_SMP=y
```

## rv32-orangecrab0285/linux/package/linux-smp/Config.in
```kconfig
config BR2_PACKAGE_LINUX_SMP
	bool "linux-smp"
	depends on BR2_LINUX_KERNEL
	help
	  The multi-hart kernel of rv32-orangecrab0285, whose bitstream is
	  built with the define CPU_COUNT 1 or 2, and ATOMIC_COHERENCE=1 at
	  2 harts: the sources and patches of the package linux, its
	  configuration linux.config merged with linux-smp.config; its Image
	  is installed to images/smp/.

comment "linux-smp needs the Linux kernel"
	depends on !BR2_LINUX_KERNEL
```
